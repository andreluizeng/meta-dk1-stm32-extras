## conf/layer.conf
```bitbake
# We have a conf and classes directory, add to BBPATH
BBPATH .= ":${LAYERDIR}"

# We have a packages directory, add to BBFILES
BBFILES += "${LAYERDIR}/recipes-*/*/*.bb"
BBFILES += "${LAYERDIR}/recipes-*/*/*.bbappend"

BBFILE_COLLECTIONS += "stm32dk1bspextra"
BBFILE_PATTERN_stm32dk1bspextra = "^${LAYERDIR}/"
BBFILE_PRIORITY_stm32dk1bspextra = "5"

LAYERDEPENDS_stm32dk1bspextra = "core stm32dk1bsp"
LAYERSERIES_COMPAT_stm32dk1bspextra = "dunfell kirkstone"

KEYSTORAGE = "${LAYERDIR}"

BBFILES_DYNAMIC += " \
	core:${LAYERDIR}/dynamic-layers/core/*/*/*.bb \
	core:${LAYERDIR}/dynamic-layers/core/*/*/*.bbappend \
	\
	openembedded-layer:${LAYERDIR}/dynamic-layers/openembedded-layer/*/*/*.bb \
	openembedded-layer:${LAYERDIR}/dynamic-layers/openembedded-layer/*/*/*.bbappend \
	"
```
